## firmware/main/Kconfig.projbuild
```kconfig
menu "Medical IoT Device"

    config MIOT_WIFI_SSID
        string "Wi-Fi SSID"
        default "myssid"

    config MIOT_WIFI_PASSWORD
        string "Wi-Fi password"
        default "mypassword"

    config MIOT_SERVER_URL
        string "Server URL for SD-card uploads"
        default "http://192.168.1.100:3000"
        help
            Address of web/server.js, e.g. http://<IP of the laptop>:3000.
            Used only by "Завантажити дані з SD" (POST /api/sd-upload);
            live telemetry and commands go through Azure IoT Hub.

    config MIOT_API_KEY
        string "X-API-Key header (leave empty if server has none)"
        default ""

    config MIOT_DEVICE_ID
        string "device_id reported to the server"
        default "esp32c6-01"

    config MIOT_SPO2_COEF_A_X100
        int "SpO2 curve SpO2 = A - B*R: A x100"
        default 11000
        help
            Intercept of the linear SpO2 calibration, in hundredths
            (11000 = 110.00). Default is the common uncalibrated 110 - 25*R.

    config MIOT_SPO2_COEF_B_X100
        int "SpO2 curve SpO2 = A - B*R: B x100"
        default 2500
        help
            Slope of the linear SpO2 calibration, in hundredths (2500 = 25.00).

    config MIOT_MAX30102_LEDS_SWAPPED
        bool "MAX30102 board has red and IR LEDs swapped"
        default n
        help
            Some MAX30102 breakout boards have the two LEDs fitted the other
            way round (datasheet: LED1 = red, LED2 = IR). Check with the LED
            test in calibration mode: if the visibly red glow appears while
            only LED2 is on, enable this.

    config MIOT_TEMP_TISSUE_K_X100
        int "Body-temperature estimate: tissue/ambient coefficient k, x100"
        default 19
        help
            The TMP117 (factory-accurate, +-0.1 C) reads fingertip skin
            temperature, which is what the dashboard shows. The approximate
            body temperature shown next to it is computed, not a fixed
            offset: heat flows from the body core through the finger out to
            the room, so the core is warmer than the skin by an amount that
            grows with the skin-to-room difference:
                body = skin + k * (skin - room)
            "room" is measured by the same sensor while nobody touches it.
            k = 0.19 (19) from a healthy adult: skin 35.43 C, room 28.83 C,
            body ~36.7 C.

    config MIOT_BOOT_LOCKOUT_S
        int "No measurements for this many seconds after power-on"
        range 0 3600
        default 600
        help
            Sensor warm-up: measurement requests are ignored for this long
            after the board powers on and the dashboard shows a countdown.
            "Виміряти все одно" on the dashboard or a double press on the
            button still starts a measurement. 0 disables the lockout.

    config MIOT_CALIBRATION_MODE
        bool "Calibration mode (raw sensor values to serial, everything always on)"
        default n
        help
            For calibrating: skips the boot lockout, keeps ECG, pulse/SpO2
            and temperature measuring continuously, and prints one line per
            second to the serial console:
            CAL,uptime_s,temp_c_raw,ir_dc,ir_ac_rms,red_dc,red_ac_rms,R,hr,quality,spo2,finger,pulse_ok,lod,adc_sps,dup_reads
            and ECG,<sample> lines at 200 Hz. Wi-Fi stays off (no network noise).
            Never leave this on in a normal build.

    config MIOT_AZURE_ENABLE
        bool "Send telemetry to Azure IoT Hub"
        default y
        help
            Publishes the same JSON payload to Azure IoT Hub over MQTT
            (mqtts://<hub>.azure-devices.net:8883, TLS, SAS token generated
            on the device). The dashboard reads it back through the hub's
            built-in Event Hub-compatible endpoint (web/src/azure-ingest.js).
            This is the only live data path: with it off, measurements
            only go to the SD card.

    config MIOT_AZURE_CONNECTION_STRING
        string "Azure IoT Hub device connection string"
        depends on MIOT_AZURE_ENABLE
        default ""
        help
            HostName=<hub>.azure-devices.net;DeviceId=<id>;SharedAccessKey=<key>
            - the device's "Primary connection string" from the portal or
            `az iot hub device-identity connection-string show`.
            Keep it out of git: put it in sdkconfig.defaults.local or set
            it in menuconfig (sdkconfig is not committed).

    config MIOT_AZURE_IDLE_PERIOD_S
        int "Seconds between idle status messages to Azure"
        depends on MIOT_AZURE_ENABLE
        range 1 3600
        default 60
        help
            While no measurement is running only one status message per
            this many seconds goes to Azure (measurement data is always
            sent). The free F1 tier allows 8000 messages/day.

endmenu
```
