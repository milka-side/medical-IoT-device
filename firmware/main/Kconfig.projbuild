## firmware/main/Kconfig.projbuild
```kconfig
menu "Medical IoT Device"

    config MIOT_WIFI_SSID
        string "Wi-Fi SSID"
        default "myssid"

    config MIOT_WIFI_PASSWORD
        string "Wi-Fi password"
        default "mypassword"

    config MIOT_SERVER_URL
        string "Server URL for telemetry POST"
        default "http://192.168.1.100:3000/api/data"
        help
            Full URL of the web/server.js endpoint, e.g.
            http://<IP of the computer running npm start>:3000/api/data

    config MIOT_API_KEY
        string "X-API-Key header (leave empty if server has none)"
        default ""

    config MIOT_DEVICE_ID
        string "device_id reported to the server"
        default "esp32c6-01"

    config MIOT_COMMAND_URL
        string "Server URL for command polling (GET /api/command)"
        default "http://192.168.1.100:3000/api/command"
        help
            Same host/port as Server URL above, just the /api/command
            endpoint. Polled once a second while idle so a dashboard button
            press is picked up within ~1s without keeping a connection open.

    config MIOT_MQTT_ENABLE
        bool "Also publish telemetry over MQTT"
        default n
        help
            Publishes the same JSON payload used for the HTTP POST to an
            MQTT broker, on topic wearable/<device_id>/data - matches
            web/src/mqtt-ingest.js's default subscription (wearable/+/data).
            Runs alongside the HTTP POST, not instead of it.

    config MIOT_MQTT_URL
        string "MQTT broker URI (mqtt:// or mqtts://)"
        depends on MIOT_MQTT_ENABLE
        default "mqtt://192.168.1.100:1883"
        help
            Passed straight to esp-mqtt as broker.address.uri, e.g.
            mqtt://<IP of the computer running the broker>:1883.

    config MIOT_MQTT_USERNAME
        string "MQTT username (leave empty if broker has none)"
        depends on MIOT_MQTT_ENABLE
        default ""

    config MIOT_MQTT_PASSWORD
        string "MQTT password (leave empty if broker has none)"
        depends on MIOT_MQTT_ENABLE
        default ""

    config MIOT_AZURE_ENABLE
        bool "Also publish telemetry to Azure IoT Hub"
        default n
        help
            Publishes the same JSON payload to Azure IoT Hub over MQTT
            (mqtts://<hub>.azure-devices.net:8883, TLS, SAS token generated
            on the device). The dashboard reads it back through the hub's
            built-in Event Hub-compatible endpoint (web/src/azure-ingest.js).
            Runs alongside the HTTP POST, not instead of it.

    config MIOT_AZURE_CONNECTION_STRING
        string "Azure IoT Hub device connection string"
        depends on MIOT_AZURE_ENABLE
        default ""
        help
            HostName=<hub>.azure-devices.net;DeviceId=<id>;SharedAccessKey=<key>
            - the device's "Primary connection string" from the portal or
            `az iot hub device-identity connection-string show`.
            Keep it out of git: put it in sdkconfig.defaults.local or set
            it in menuconfig (sdkconfig is not committed).

    config MIOT_AZURE_IDLE_PERIOD_S
        int "Seconds between idle status messages to Azure"
        depends on MIOT_AZURE_ENABLE
        range 1 3600
        default 60
        help
            While no measurement is running only one status message per
            this many seconds goes to Azure (measurement data is always
            sent). The free F1 tier allows 8000 messages/day.

endmenu
```
